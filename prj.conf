## CMakeLists.txt
```
# SPDX-License-Identifier: Apache-2.0

cmake_minimum_required(VERSION 3.20.0)

find_package(Zephyr REQUIRED HINTS $ENV{ZEPHYR_BASE})
project(my-blinky-app-cpp)

# Specify the C++ standard for the target
target_compile_features(app PRIVATE cxx_std_20)

# Point to the C++ source file
target_sources(app PRIVATE src/main.cpp)
```

## prj.conf
```kconfig
# SPDX-License-Identifier: Apache-2.0

# Base C++ Config & Drivers
CONFIG_GPIO=y
CONFIG_CPP=y
CONFIG_STD_CPP20=y
CONFIG_NEWLIB_LIBC=y
CONFIG_SERIAL=y
CONFIG_UART_CONSOLE=y

# --- Logging Subsystem ---
CONFIG_LOG_MODE_IMMEDIATE=y
CONFIG_LOG_BACKEND_UART=y
CONFIG_LOG_DEFAULT_LEVEL=3

# --- Networking Stack ---
CONFIG_NETWORKING=y
CONFIG_NET_L2_ETHERNET=y
CONFIG_NET_LOG=y

# IPv6 Configuration
CONFIG_NET_IPV6=y
CONFIG_NET_CONFIG_SETTINGS=y
CONFIG_NET_CONFIG_NEED_IPV6=y
# By removing AUTO_INIT, we prevent the blocking wait at boot.
# The network interface will still be created and should be configured
# by the stack without halting the entire boot sequence.
# CONFIG_NET_CONFIG_AUTO_INIT is not set

# --- USB Device Stack ---
CONFIG_USB_DEVICE_STACK=y
CONFIG_USB_DEVICE_VID=0x1209
CONFIG_USB_DEVICE_PID=0x0001
CONFIG_USB_DEVICE_MANUFACTURER="WB7NAB"
CONFIG_USB_DEVICE_PRODUCT="SDR Txcvr"
CONFIG_USB_DEVICE_INITIALIZE_AT_BOOT=y
CONFIG_USB_DC_STM32=y

# --- USB Classes ---
CONFIG_USB_CDC_ACM=y
CONFIG_USB_DEVICE_NETWORK_ECM=y

# Kernel options for networking threads
CONFIG_MAIN_STACK_SIZE=4096
CONFIG_SYSTEM_WORKQUEUE_STACK_SIZE=4096

# Memory configuration - use automatic heap sizing
# Setting to 0 tells Zephyr to use all available RAM after static allocation
CONFIG_HEAP_MEM_POOL_SIZE=0
```

## nucleo_h753zi.overlay
```dts
/*
 * SPDX-License-Identifier: Apache-2.0
 */

/* Enable the USB OTG Full-Speed peripheral */
&usbotg_fs {
	status = "okay";

	/* Create the required node for the CDC ACM virtual UART */
	cdc_acm_uart: cdc_acm_uart {
		compatible = "zephyr,cdc-acm-uart";
		label = "CDC_ACM_0";
	};
};

/*
 * You can optionally set the USB CDC ACM as the system console.
 * This will redirect printk and logging output to the USB virtual COM port
 * instead of the ST-LINK VCP.
 */
/*
/ {
	chosen {
		zephyr,console = &cdc_acm_uart;
	};
};
*/
```

## src/main.cpp
```c
#include <zephyr/kernel.h>
#include <zephyr/drivers/gpio.h>
#include <zephyr/logging/log.h>

// Initialize the logger for this module
LOG_MODULE_REGISTER(main_app, LOG_LEVEL_INF);

// The time to sleep between toggles, in milliseconds
constexpr int sleepTimeMs = 1000;

// Get the node identifier for the alias 'led0' from the device tree.
#define LED0_NODE DT_ALIAS(led0)

/**
 * @brief Manages the configuration and blinking of an LED to show activity.
 */
class Blinker {
public:
  Blinker() : led(GPIO_DT_SPEC_GET(LED0_NODE, gpios)) {
    if (!device_is_ready(led.port)) {
      LOG_ERR("Error: GPIO device %s is not ready", led.port->name);
      isReady = false;
      return;
    }

    int ret = gpio_pin_configure_dt(&led, GPIO_OUTPUT_ACTIVE);
    if (ret < 0) {
      LOG_ERR("Error %d: failed to configure %s pin %d", ret, led.port->name, led.pin);
      isReady = false;
      return;
    }
    LOG_INF("Blinker initialized successfully for %s pin %d", 
            led.port->name, led.pin);
    isReady = true;
  }

  void run() {
    if (!isReady) {
      return;
    }
    while (1) {
      gpio_pin_toggle_dt(&led);
      k_msleep(sleepTimeMs);
    }
  }

private:
  const struct gpio_dt_spec led;
  bool isReady = false;
};

/**
 * @brief Main entry point for the application.
 */
int main() {
  LOG_INF("Application started");
  LOG_INF("USB stack will be initialized automatically by the system.");
  LOG_INF("Waiting for host connection on USB_OTG_FS port...");

  Blinker blinker;
  blinker.run();

  return 0; // Should not be reached.
}
```
